## boards/shields/jd_dm/Kconfig.defconfig
```kconfig
# Copyright (C) 2024 James-delorenzo
# SPDX-License-Identifier: MIT

if SHIELD_JD_DM

config ZMK_KEYBOARD_NAME
    default "delo dactyl"

config ZMK_SPLIT_ROLE_CENTRAL
    default y

endif

if SHIELD_JD_DM_LEFT

config ZMK_KEYBOARD_NAME
    default "delo dactly"

config ZMK_SPLIT_ROLE_CENTRAL
    default y

endif

if SHIELD_JD_DM_LEFT || SHIELD_JD_DM_RIGHT

config ZMK_SPLIT
    default y

endif # SHIELD_JD_DM_LEFT || SHIELD_JD_DM_RIGHT

if ZMK_DISPLAY

# config I2C
#     default y
#
# config SSD1306
#     default y
#
# config SSD1306_REVERSE_MODE
#     default y

endif # ZMK_DISPLAY

if LVGL

config LV_Z_VDB_SIZE
    default 64

config LV_DPI_DEF
    default 148

config LV_Z_BITS_PER_PIXEL
    default 1

choice LV_COLOR_DEPTH
    default LV_COLOR_DEPTH_1
endchoice

endif # LVGL
```

## boards/shields/jd_dm/Kconfig.shield
```kconfig
# Copyright (C) 2024 James-delorenzo
# SPDX-License-Identifier: MIT

config SHIELD_JD_DM
    bool

config SHIELD_JD_DM_LEFT
    def_bool $(shields_list_contains,jd_dm_left)

config SHIELD_JD_DM_RIGHT
    def_bool $(shields_list_contains,jd_dm_right)
```
