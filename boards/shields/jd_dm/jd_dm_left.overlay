/*
* Copyright (C) 2024 James-delorenzo
* SPDX-License-Identifier: MIT
*/

#include "jd_dm.dtsi"

&kscan0 {
    col-gpios = <&pro_micro 8 (GPIO_ACTIVE_HIGH> | GPIO_PULL_DOWN),
                <&pro_micro 7 (GPIO_ACTIVE_HIGH> | GPIO_PULL_DOWN),
                <&pro_micro 6 (GPIO_ACTIVE_HIGH> | GPIO_PULL_DOWN),
                <&pro_micro 5 (GPIO_ACTIVE_HIGH> | GPIO_PULL_DOWN),
                <&pro_micro 4 (GPIO_ACTIVE_HIGH> | GPIO_PULL_DOWN),
                <&pro_micro 3 (GPIO_ACTIVE_HIGH> | GPIO_PULL_DOWN);
};
